## sound/soc/hda/Kconfig
```kconfig
config SND_SOC_HDA_INTEL
	tristate "ASoC Intel HD Audio"
	select SND_CORE_HDA
	select SND_SOC_HDA_BUS
	select SND_SOC_HDA_SST_DSP
	help
	Say Y here to include support for ASoC Intel "High Definition
	Audio" (Azalia) and its compatible devices.

	To compile this driver as a module, choose M here: the module
	will be called snd-soc-hda-intel.

if  SND_SOC_HDA_INTEL

	config SND_HDA_PREALLOC_SIZE
	int "Pre-allocated buffer size for HD-audio driver"
	range 0 32768
	default 64
	help
	Specifies the default pre-allocated buffer-size in kB for the
	HD-audio driver.  A larger buffer (e.g. 2048) is preferred
	for systems using PulseAudio.  The default 64 is chosen just
	for compatibility reasons.

	Note that the pre-allocation size can be changed dynamically
	via a proc file (/proc/asound/card*/pcm*/sub*/prealloc), too.

config SND_HDA_INTEL_SKL_FPGA
	tristate "Intel HD Audio SKL FPGA"
        help
	Say Y here to enable the support for SKL/SPT audio FPGA Device
	To compile this driver as a module, choose M here.
endif

config SND_SOC_HDA_SST_DSP
	tristate "Enable SST DSP Library"
	help
	  Say Y here to enable the HD-audio SST dsp library.

config SND_SOC_HDA_MRGFLD_MACH
	tristate "SOC Machine Audio driver for MRGFLD HDA"
	select SND_SOC_FLORIDA
	select SND_SOC_WM_ADSP
	select SND_SOC_ARIZONA
	select MFD_ARIZONA
	select MFD_FLORIDA
	select REGULATOR_ARIZONA
	select GPIO_ARIZONA
	select SND_SOC_HDMI
	select SND_SOC_HDA_BUS
	help
	This adds support for ASoC machine driver . This will create an alsa
	sound card.
	Say Y if you have such a device
	If unsure select "N".

config SND_SOC_HDA_SKL_MACH
	tristate "SOC Machine Audio driver for SKL HDA"
	select SND_SOC_HDA_BUS
	select SND_SOC_ALC269
	select SND_SOC_HDMI
	help
	This adds support for ASoC machine driver . This will create an alsa
	sound card.
	Say Y if you have such a device
	If unsure select "N".

config SND_SOC_HDA_GENERIC_MACH
	tristate "SOC Machine Audio driver for HDA"
	select SND_SOC_HDA_BUS
	select SND_SOC_ALC269
	select SND_SOC_HDMI
	help
	This adds support for ASoC machine driver . This will create an alsa
	sound card.
	Say Y if you have such a device
	If unsure select "N".

config SND_SOC_HDA_BUS
	tristate "SOC HDA bus driver"
	help
	 This adds support the generic SOC HDA Bus Core library
```
